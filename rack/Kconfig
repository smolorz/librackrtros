## rack/Kconfig
```kconfig
config RACKRTROS_VERSION
    string
    default "0.0.1"

mainmenu "RACKRTROS configuration"

menu "Build options"

config RACKRTROS_LIRE_INSTALLDIR
    string "LiRE Installdir (READ HELP!)"
    default "/home/`whoami`/LiRE"
    help
    If you specify the LiRE installdir all dependencies which normally are
    located inside the installdir do not need to be declared explicitly.
    This goes for all external dependencies like xenomai and all libraries.
    Nevertheless, you can still state an explicit path for every dependency
    if this is necessary.

choice
    prompt "Target OS"
    default RACKRTROS_OS_LINUX

config RACKRTROS_OS_XENOMAI
    bool "Xenomai"

config RACKRTROS_OS_LINUX
    bool "Linux"

endchoice

config RACKRTROS_EXT_XENOMAIDIR
    bool "Specify Xenomai installation tree explicitly"
    default n
    depends on RACKRTROS_OS_XENOMAI

config RACKRTROS_XENOMAIDIR
    string "Xenomai installation tree"
    depends on RACKRTROS_EXT_XENOMAIDIR
    default "/usr/xenomai"
    help
    This option defines the directory where Xenomai is installed
    The default Xenomai installation directory is
    /usr/xenomai

config RACKRTROS_BUILD_KMOD
    bool "Build kernel modules"
    depends on RACKRTROS_OS_XENOMAI
    default y

config RACKRTROS_LINUXDIR
    string "Linux source tree"
    depends on RACKRTROS_BUILD_KMOD
    default "/lib/modules/`uname -r`/build"
    help
    This option defines the directory of the Linux sources
    The default Linux source directory is
    /lib/modules/`uname -r`/build

config RACKRTROS_INSTALLDIR
    string "Installation directory"
    default "/home/`whoami`/rack_install"
    help
    This option defines the directory where the various RACK
    files will be installed on your system.
    
config RACKRTROS_JAVA
    bool "Rack Java"
    default y

config RACKRTROS_JAVA_GUI
    bool "Rack Java Gui"
    default y
    depends on RACKRTROS_JAVA

config RACKRTROS_DOC_DOX
    bool "Generate Rack Doxygen API"
    default n

config RACKRTROS_CROSS_COMPILE
    bool "Use own toolchain"
    default y

config RACKRTROS_TARGET_TUPLE
    string "target tuple or alias"
    default i586-nptl-linux-gnu
    depends on RACKRTROS_CROSS_COMPILE

config RACKRTROS_TOOLCHAIN_PARENT_DIR
    string "Parent directory of the toolchain"
    default /opt
    depends on RACKRTROS_CROSS_COMPILE

endmenu

menu "Advanced settings"

choice
    prompt "Message size and data format in proxies"
    default RACKRTROS_PROXIES_MSG_SIZE_SCANDRIVE

config RACKRTROS_PROXIES_MSG_SIZE_SCANDRIVE
    bool "Use ScanDrive"

config RACKRTROS_PROXIES_MSG_SIZE_VELODYNE
    bool "Use Velodyne"

config RACKRTROS_PROXIES_MSG_SIZE_KINECT
    bool "Use Kinect"

endchoice

endmenu
```
